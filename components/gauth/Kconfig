## components/gauth/Kconfig
```kconfig
menu "HomePlanner: Sign in with Google"

    config HP_GOOGLE_CLIENT_ID
        string "OAuth client ID"
        default ""
        help
            The project's Google OAuth client (type "Web application"), e.g.
            1234-abc.apps.googleusercontent.com. Set it in secrets.defaults (see README).

    config HP_GOOGLE_CLIENT_SECRET
        string "OAuth client secret"
        default ""

    config HP_GOOGLE_REDIRECT_URI
        string "Sign-in relay page (registered as the client's redirect URI)"
        default "https://wentzeld.github.io/homeplanner-esp32/oauth.html"

endmenu
```

## components/model/Kconfig
```kconfig
menu "HomePlanner: demo"
    config HP_DEMO
        bool "Demo mode: made-up family, events and weather"
        default n
        help
            Shows a made-up family calendar instead of Google (for screenshots), with no Google
            sign-in, no update checks and nothing saved to flash. Build it with tools/demo.sh.
            Never release a build with this on.
endmenu
```

## components/update/Kconfig
```kconfig
menu "HomePlanner: software updates"

    config HP_UPDATE_REPO
        string "GitHub repository with the releases (owner/name)"
        default "wentzeld/homeplanner-esp32"

    config HP_OTA_TEST_NEVER_GOOD
        bool "Test build: never confirm itself (to test automatic rollback)"
        default n
        help
            Only for testing: this firmware never marks itself as working, so 5 minutes after an
            update the panel goes back to the previous version. Never release a build with this on.

    config HP_UPDATE_TEST_SCREEN_ON
        bool "Test build: keep the screen on while an update is written"
        default n
        help
            Only for testing flash auto-suspend: normally the screen is turned off while an update is
            written, because the flash writes make it flicker. Never release a build with this on.

endmenu
```
